## meta-sunxi/conf/machine/bananapi.conf
```bitbake
#@TYPE: Machine
#@NAME: Bananapi
#@DESCRIPTION: Machine configuration for the bananapi, based on allwinner A20 CPU http://bananapi.org/

require conf/machine/include/sun50i.inc

KERNEL_DEVICETREE = "sun50i-a64-bananapi-m64.dtb"

UBOOT_MACHINE = "Bananapi_config"

#SUNXI_FEX_FILE = "sys_config/a20/Bananapi.fex"
SUNXI_FEX_FILE = "sys_config/r18.fex"
```
